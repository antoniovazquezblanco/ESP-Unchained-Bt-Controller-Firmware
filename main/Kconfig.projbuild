## main/Kconfig.projbuild
```kconfig
# SPDX-FileCopyrightText: 2026 Antonio Vázquez Blanco <antoniovazquezblanco@gmail.com>
# SPDX-License-Identifier: GPL-3.0-or-later

menu "ESP Unchained display"

config UNCHAINED_DISPLAY_ENABLED
    bool "Enable ST7789 SPI display support"
    default n
    help
        Bring up an ST7789 SPI TFT via esp_lcd.

if UNCHAINED_DISPLAY_ENABLED

config UNCHAINED_DISPLAY_LOGO
    bool "Show the logo image on the boot splash"
    default y
    help
        Draw the pixel-art boot logo -- an embedded ~150 KB RGB565 image -- on the
        splash screen. Turn this off on flash-constrained boards; the splash then
        shows just the firmware name. When enabled, the build generates the image
        header (logo_img.h) from utils/logo -- this needs Pillow in the build
        Python (pip install pillow). The header itself is not checked in.

config UNCHAINED_DISPLAY_LOGO_LINKS
    int "Logo chain links per side"
    depends on UNCHAINED_DISPLAY_LOGO
    default 2
    help
        Mid chain sections on each side of the rune. The logo is scaled by the largest integer factor that fits the panel and the splash text sits below a 2x logo, so pick the count that renders at 2x (2 for 320x240, 0 for 240x135).

config UNCHAINED_DISPLAY_SPI_HOST
    int "SPI host (1=SPI2, 2=SPI3)"
    default 1

config UNCHAINED_DISPLAY_SCLK_GPIO
    int "SCLK GPIO"
    default -1

config UNCHAINED_DISPLAY_MOSI_GPIO
    int "MOSI GPIO"
    default -1

config UNCHAINED_DISPLAY_CS_GPIO
    int "CS GPIO"
    default -1

config UNCHAINED_DISPLAY_DC_GPIO
    int "DC GPIO"
    default -1

config UNCHAINED_DISPLAY_RST_GPIO
    int "RST GPIO (-1 = software reset)"
    default -1
    help
        Default -1 uses the ST7789 software reset command. Set a real pin here if the board wires one.

config UNCHAINED_DISPLAY_BL_GPIO
    int "Backlight GPIO (-1 = none / always on)"
    default -1

config UNCHAINED_DISPLAY_BL_ACTIVE_HIGH
    bool "Backlight active high"
    default y

config UNCHAINED_DISPLAY_PCLK_HZ
    int "SPI pixel clock (Hz)"
    default 20000000

config UNCHAINED_DISPLAY_WIDTH
    int "Panel width (px)"
    default 240

config UNCHAINED_DISPLAY_HEIGHT
    int "Panel height (px)"
    default 240

config UNCHAINED_DISPLAY_X_GAP
    int "Panel column offset (px)"
    default 0
    help
        Where the visible area starts in the controller's RAM, after rotation. Needed by panels smaller than the ST7789's 240x320 RAM, such as 135x240.

config UNCHAINED_DISPLAY_Y_GAP
    int "Panel row offset (px)"
    default 0
    help
        Row counterpart of UNCHAINED_DISPLAY_X_GAP.

config UNCHAINED_DISPLAY_BGR_ORDER
    bool "Panel expects BGR subpixel order"
    default n
    help
        Set for panels wired BGR rather than RGB. Wrong setting swaps red and blue; it does not blank the screen.

endif # UNCHAINED_DISPLAY_ENABLED

endmenu

menu "ESP Unchained status LEDs"

config UNCHAINED_LED_ENABLED
    bool "Enable addressable status LED(s)"
    default n
    help
        Drive an addressable RGB LED (WS2812 / SK6812 / SK6805) over RMT as a
        controller status indicator: idle heartbeat, HCI traffic, capture activity
        and dropped packets. Off by default; boards that wire one enable it in
        boards/<name>.defaults.

if UNCHAINED_LED_ENABLED

config UNCHAINED_LED_GPIO
    int "LED data GPIO"
    default -1
    help
        GPIO wired to the LED (strip) data-in. Required; the build errors if unset.

config UNCHAINED_LED_COUNT
    int "Number of LEDs on the data line"
    default 1
    help
        Total pixels on the strip. One is the usual case (a single onboard RGB).
        Boards with more drive a few of them as the status indicator and paint the
        rest a static accent colour (see below).

config UNCHAINED_LED_STATUS_FIRST
    int "Index of the first status pixel"
    default 0
    help
        Where the status indicator starts on the strip. Pixels outside the status
        range show UNCHAINED_LED_ACCENT_RGB.

config UNCHAINED_LED_STATUS_COUNT
    int "How many consecutive pixels show the status"
    default 1
    help
        The status indicator spans this many pixels from UNCHAINED_LED_STATUS_FIRST,
        all showing the same colour -- e.g. both LEDs of a two-pixel logo.

config UNCHAINED_LED_ACCENT_FIRST
    int "Index of the first accent pixel"
    default 0
    help
        Where the static accent range starts on the strip.

config UNCHAINED_LED_ACCENT_COUNT
    int "How many consecutive pixels show the accent colour"
    default 0
    help
        Pixels in this range hold UNCHAINED_LED_ACCENT_RGB. Pixels in neither the
        status nor the accent range are left off, so a strip can carry a lit brand
        accent, a status indicator, and dark pixels between them.

config UNCHAINED_LED_ACCENT_RGB
    hex "Accent colour (0xRRGGBB)"
    default 0x000000
    help
        The colour held by the accent range. Used to keep a brand accent lit while
        a sub-set of the strip reports controller status.

config UNCHAINED_LED_BRIGHTNESS
    int "Per-channel brightness ceiling (1-255)"
    default 48
    range 1 255
    help
        Caps each colour channel, status and accent alike. Keep it low on
        battery-powered boards -- a strip at full brightness is a real current draw.

endif # UNCHAINED_LED_ENABLED

endmenu

menu "ESP Unchained HCI"

# Variable to note if the controller exposes VHCI.
# The C5-era ports uses BT_LE_HCI_INTERFACE to indicate this.
# The C3-era ones BT_CTRL_HCI_MODE
# The classic ESP32 BTDM_CTRL_HCI_MODE
config UNCHAINED_HCI_VHCI_AVAILABLE
    bool
    default y if BT_LE_HCI_INTERFACE_USE_RAM || BT_CTRL_HCI_MODE_VHCI || BTDM_CTRL_HCI_MODE_VHCI

choice UNCHAINED_HCI_TRANSPORT
    prompt "HCI transport exposed to the host"
    depends on UNCHAINED_HCI_VHCI_AVAILABLE
    default UNCHAINED_HCI_TRANSPORT_NONE
    help
        Which transport the controller's VHCI interface is bridged to, turning the board into a plain H4 HCI controller on that link.

config UNCHAINED_HCI_TRANSPORT_NONE
    bool "None"
    help
        Do not bridge VHCI anywhere. The controller comes up but no host can reach it, so pick this only for a board that talks to the controller some other way.

config UNCHAINED_HCI_OVER_USB_SERIAL_JTAG
    bool "Native USB-Serial/JTAG"
    depends on SOC_USB_SERIAL_JTAG_SUPPORTED
    help
        Expose the controller as a plain H4 HCI device on the chip's USB socket, so no external UART adapter is needed. The endpoint must not also carry the console -- set CONFIG_ESP_CONSOLE_NONE, or move the console elsewhere.

config UNCHAINED_HCI_OVER_UART
    bool "Hardware UART"
    help
        Bridge the controller's VHCI to a hardware UART, so the board is a plain H4 HCI controller over that UART. Use this on chips without a native USB-Serial/JTAG (e.g. the classic ESP32, reached through its onboard USB-UART bridge on UART0). The chosen UART must not also carry the console -- set CONFIG_ESP_CONSOLE_NONE, or move the console to another UART.

config UNCHAINED_HCI_OVER_USB_BTH
    bool "Native USB Bluetooth (USB-OTG, BTH class)"
    depends on SOC_USB_OTG_SUPPORTED
    help
        Expose the controller through the chip's USB-OTG port as a standard USB Bluetooth HCI device (Wireless Controller class, 0xE0/01/01) over TinyUSB, so the board enumerates as a native Bluetooth dongle -- Linux btusb binds it as an hciX adapter with no H4 attach. Unlike the H4 transports there is no framing on the wire: HCI commands arrive on the control endpoint, events go back on an interrupt endpoint and ACL data on bulk endpoints. S3-only (needs USB-OTG); it shares the native USB pins with USB-Serial/JTAG, so only one of the two can own that port.

endchoice

if UNCHAINED_HCI_OVER_UART

config UNCHAINED_HCI_UART_NUM
    int "HCI UART port number"
    default 0

config UNCHAINED_HCI_UART_TX_GPIO
    int "HCI UART TX GPIO"
    default 1

config UNCHAINED_HCI_UART_RX_GPIO
    int "HCI UART RX GPIO"
    default 3

config UNCHAINED_HCI_UART_BAUD
    int "HCI UART baud rate"
    default 921600

endif # UNCHAINED_HCI_OVER_UART

endmenu
```
